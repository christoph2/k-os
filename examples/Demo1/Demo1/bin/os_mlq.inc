C:\projekte\eOSEK\trunk\os_mlq.c :   \
	C:\projekte\eOSEK\trunk\os_mlq.h \
	C:\projekte\eOSEK\trunk\osek.h \
	C:\projekte\csProjects\trunk\autosar\Std_Macros.h \
	C:\projekte\eOSEK\trunk\Os_Cfg.h \
	C:\projekte\eOSEK\trunk\Os_Defs.h \
	C:\projekte\csProjects\trunk\autosar\Std_Types.h \
	C:\projekte\csProjects\trunk\autosar\Platform_Types.h \
	C:\projekte\csProjects\trunk\autosar\compiler.h \
	C:\projekte\eOSEK\trunk\os_types.h \
	C:\projekte\eOSEK\trunk\Port.h \
	C:\projekte\csProjects\trunk\InstallIsr\ISR.h \
	C:\projekte\csProjects\trunk\InstallISR\metrowerks\ISR_MW.h \
	C:\projekte\csProjects\trunk\InstallISR\metrowerks/hcs12\ISR_MW_HCS12.h \
	C:\projekte\eOSEK\trunk\ISR_Cfg.h \
	C:\projekte\eOSEK\trunk\Hw_Cfg.h \
	C:\projekte\csProjects\trunk\drivers\include\cpu12\S12_Atd.h \
	C:\projekte\csProjects\trunk\autosar\CPU_Primitives.h \
	C:\projekte\csProjects\trunk\InstallISR\ISR.h \
	C:\projekte\csProjects\trunk\drivers\include\cpu12\S12_Crg.h \
	C:\projekte\csProjects\trunk\drivers\include\cpu12\S12_Mebi.h \
	C:\projekte\csProjects\trunk\drivers\include\cpu12\S12_Can.h \
	C:\projekte\csProjects\trunk\common\include\Utl.h \
	C:\projekte\csProjects\trunk\drivers\include\cpu12\S12_Ect.h \
	C:\projekte\csProjects\trunk\drivers\include\cpu12\S12_Iic.h \
	C:\projekte\csProjects\trunk\drivers\include\cpu12\S12_Sci.h \
	C:\projekte\eOSEK\trunk\Os_Error.h \
	C:\projekte\eOSEK\trunk\Os_Vars.h \
	C:\projekte\eOSEK\trunk\Os_Macros.h \
	C:\projekte\eOSEK\trunk\Os_Api.h \
	C:\projekte\eOSEK\trunk\Os_Alm.h \
	C:\projekte\eOSEK\trunk\Os_Ctr.h \
	C:\projekte\eOSEK\trunk\Os_Evt.h \
	C:\projekte\eOSEK\trunk\Os_Exec.h \
	C:\projekte\eOSEK\trunk\Os_Intr.h \
	C:\projekte\eOSEK\trunk\Os_MLQ.h \
	C:\projekte\eOSEK\trunk\Os_Res.h \
	C:\projekte\eOSEK\trunk\Os_Task.h \
	C:\projekte\eOSEK\trunk\Os_SchT.h \
	C:\projekte\eOSEK\trunk\Osek.h
