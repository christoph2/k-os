 winclear

 if ice()
 (
  sys.m ai
  map.res
  map.m fast
  map.def 0x1000--0x0ffff
  map.opf 0x8000--0x8fff

;disable rom 
  d.s 0x013 0x0e

 )

 if bdm()
 (
  sys.u
  d.s 0x0a 0x2c
  d.s 0x0a 0x2c	
;needed 2 times

;set operating Mode
  d.s 0x0b 0x7b
  d.s 0x0b 0x7b

;disable watchdog
  d.s 0x16 0x0	

;set chip selects
  d.s 0x3c 0x30	
  d.s 0x3d 0x10	

;set EEPROM to $1000
  d.s 0x12 0x11
;enable protect bits (EEPROM)
  d.s 0x3e 0x5
  d.s 0x0f0 0x0fc	

;no protect to EEPROM
  d.s 0x0f1 0x0	

 )

 if simulator()
 (
  sys.u
 )

;map internal RAM to 0800
 Data.Set 0x10 0x08

 d.load.elf c:\projekte\eosek\trunk\target\Metrowerks4.6\miniOSEK\bin\CGeneric.abs /col /spath
 g main

 winpos 0% 0% 100% 50%
 w.d.l
 winpos 0% 50% 50% 50%
 w.v.f /l /c
 winpos 50% 50% 50% 50%
 w.v.w
 v.aw flags ast
 enddo












